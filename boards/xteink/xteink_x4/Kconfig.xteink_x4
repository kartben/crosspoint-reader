## boards/xteink/xteink_x4/Kconfig.xteink_x4
```kconfig
# SPDX-License-Identifier: MIT

config BOARD_XTEINK_X4
	select SOC_ESP32C3_MINI_N4
```

## west.yml
```yaml
# SPDX-License-Identifier: MIT

manifest:
  self:
    path: .

  remotes:
    - name: zephyrproject-rtos
      url-base: https://github.com/zephyrproject-rtos

  projects:
    - name: zephyr
      remote: zephyrproject-rtos
      revision: v4.4.0
      path: deps/zephyr
      west-commands: scripts/west-commands.yml
      import:
        name-allowlist:
          - cmsis
          - cmsis_6
          - fatfs
          - hal_espressif
```
